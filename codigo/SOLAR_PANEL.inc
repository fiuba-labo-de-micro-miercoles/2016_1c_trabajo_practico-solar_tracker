;-------------------------------------------------------------------------

							SOLAR_PANEL.inc

;-------------------------------------------------------------------------

READ_V_SOLAR_PANEL:
;RECIBE: NADA
;DEVUELVE: TENSION DEL PANEL EN ADC_DATA_H
	LDI ADC_DATA_L,ADC_SOLAR_PANEL			;ELIJO EL PIN DEL PANEL SOLAR
	RCALL ADC_SELECT_INPUT					;LLAMO LA FUNCION PARA SELECCIONAR EL PANEL SOLAR
	RCALL ADC_SIMPLE_CONVERSION				;LLAMO LA FUNCION PARA MEDIR
RET

CHECK_IF_SOLAR_PANEL_MINIMUM:
;RECIBE: TENSION DEL PANEL EN ADC_DATA_H
;DEVUELVE: [CARRY=1]: SOLAR_PANEL LOW. [CARRY=0]: SOLAR_PANEL OK
	CLC
	CPI		ADC_DATA_H,MIN_SOLAR_PANEL_VALUE	;COMPARAR PARA VER SI ES DE DIA O NOCHE
	BRCS	LOW_SOLAR_PANEL						;[CARRY=1]: SOLAR_PANEL LOW. [CARRY=0]: SOLAR_PANEL OK
RET

INDICATE_SOLAR_PANEL_OK:
	INPUT	AUX,PORTC
	ANDI	AUX,(~((1<<PIN_SOLAR_PANEL_LED_OK)|(1<<PIN_SOLAR_PANEL_LED_LOW)))
	ORI		AUX,(1<<PIN_BATTERY_LED_OK)
	OUTPUT	PORTC,AUX
	SEC										;[CARRY=1]: ES DE DIA. [CARRY=0]: ES DE NOCHE.
RET

INDICATE_SOLAR_PANEL_LOW:
	INPUT	AUX,PORTC
	ANDI	AUX,(~((1<<PIN_SOLAR_PANEL_LED_OK)|(1<<PIN_SOLAR_PANEL_LED_LOW)))
	ORI		AUX,(1<<PIN_BATTERY_LED_LOW)
	OUTPUT	PORTC,AUX
	CLC										;[CARRY=1]: ES DE DIA. [CARRY=0]: ES DE NOCHE.
RET

ORIENTATE_SOLAR_PANEL:
;YA ESTAN LOS PROMEDIOS DE LOS LDR Y HAY QUE COMPARAR Y MOVER EL PANEL.
;PRIMERO EN ASIMUT, LUEGO EN ELEVACION.

	COMPARAR_NO_NE:

			RCALL MOTOR_ASIMUT_OFF

		INPUT AUX,LDR_NO_MEAN
		INPUT AUX1,LDR_NE_MEAN
		CP AUX,AUX1
;VER LA RESTA Y MOVER EN FUNCION DE ESO
		BRLO MOTOR_AZIMUT_LEFT

		INPUT AUX,LDR_NO_MEAN
		INPUT AUX1,LDR_NE_MEAN
		CP AUX1,AUX
		BRLO MOTOR_AZIMUT_RIGHT
	;COMPARAR_NO_SO:
	;COMPARAR_NE_SE:


RET

MOTOR_MOVE_LEFT:
;SETEO EL PWM
;SETEO LOS ENABLE
RJMP COMPARAR_NO_NE