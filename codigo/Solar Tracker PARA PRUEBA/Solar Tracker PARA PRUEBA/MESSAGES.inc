
;MENSAJES EN ROM
MSJ_PROJECT_NAME:			.DB	"BIENVENIDO!",'\r','\n',"GRACIAS POR USAR EL SOLAR TRACKER!",'\r','\n',0
MSJ_V_BAT:					.DB	"LA TENSION DE LA BATERIA ES: ",0
MSJ_V_PANEL:				.DB "LA TENSION DEL PANEL ES: ",0
MSJ_LIGHT_ON:				.DB "ENCENDISTE LA LUZ.",'\r','\n',0
MSJ_LIGHT_OFF:				.DB "APAGASTE LA LUZ.",'\r','\n',0
MSJ_AZIMUT_EAST:			.DB "SE MOVIO EL PANEL AL ESTE.",'\r','\n',0
MSJ_AZIMUT_WEST:			.DB	"SE MOVIO EL PANEL AL OESTE.",'\r','\n',0
MSJ_ELEVATION_NORTH:		.DB "SE MOVIO EL PANEL AL NORTE.",'\r','\n',0
MSJ_ELEVATION_SOUTH:		.DB	"SE MOVIO EL PANEL AL SUR.",'\r','\n',0
MSJ_MANUAL_LIGHT_OFF:		.DB "LA LUZ PASA A CONTROLARSE AUTOMATICAMENTE.",'\r','\n',0
MSJ_MANUAL_MOTORS_OFF:		.DB "LOS MOTORES PASAN A CONTROLARSE AUTOMATICAMENTE.",'\r','\n',0
MSJ_INVALID_COMMAND:		.DB "EL COMANDO INGRESADO ES INVALIDO!",'\r','\n',0
;MSJ_DISCONNECTED_BATTERY:	.DB "LA BATERIA ESTA DESCONECTADA!",'\r','\n',0
;MSJ_DISCONNECTED_PANEL:	.DB "EL PANEL ESTA DESCONECTADO!",'\r','\n',0

VPANEL_DIG_TABLE:			.DB	12,25,38,51,64,76,89,102,115,127,141,153,166,179,192,205,217,230,243,255
VPANEL_DEC_TABLE:			.DB 0,1,2,3,4,5,5,6,7,8,9

VBATTERY_DIG_TABLE:			.DB 16,32,48,65,81,97,114,130,146,163,179,195,212,228,244,255
VBATTERY_DEC_TABLE:			.DB 0,1,1,2,3,3,4,5,5,6,7,7,8,9,9




	
