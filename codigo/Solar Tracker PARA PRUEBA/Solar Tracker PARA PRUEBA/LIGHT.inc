/*
*	LIGHT.inc [COMO SI FUERA UN OBJETO]
*
*  Created: 01/06/2016 13:10:11 p.m.
*   Author: MAU
*/ 
.CSEG
;FUTURA MEJORA: HACER QUE LA LUZ SE MUEVA POR PWM EN FUNCION DE LA CARGA DE LA BATERIA
LIGHT_TURN_ON:
	INPUT AUX,BT_MANUAL_LIGHT
	CPI AUX,0xFF						;[FLAG=0xFF]: LA LUZ SE MANEJA MANUAL.
	BREQ ORDEN_BT_NO_TOCAR_LUZ		;[FLAG=0x00]: LA LUZ SE MANEJA AUTOMATICA.

	INPUT PWM_DATA,TCCR2A	;Timer/counter control register A
	ANDI PWM_DATA,(~((1<<COM2B1)|(1<<COM2B0)|(1<<WGM20)|(1<<WGM21)))
	ORI PWM_DATA,((1<<COM2B1)|(0<<COM2B0)|(1<<WGM20)|(1<<WGM21))	;fast PWM, non-inverting
	OUTPUT TCCR2A,PWM_DATA

	RCALL READ_V_BATTERY
	LDI AUX,100
	CPI	ADC_DATA_H,230
	BRSH EXC_CHARGE
	CPI	ADC_DATA_H,170
	BRSH GOOD_CHARGE
	CPI	ADC_DATA_H,150
	BRSH BAD_CHARGE
EXC_CHARGE:
	ADDI AUX,50
GOOD_CHARGE:
	ADDI AUX,50
BAD_CHARGE:
	ADDI AUX,55
	OUTPUT OCR2B,AUX

;	SER AUX
;	OUTPUT OCR2B,AUX
/*
	RCALL READ_V_SOLAR_PANEL
	CPI	ADC_DATA_H,230
	BRSH EXC_SUN
	CPI	ADC_DATA_H,170
	BRSH GOOD_SUN
	CPI	ADC_DATA_H,150
	BRSH BAD_SUN
BAD_SUN:
	ADDI AUX,50
GOOD_SUN:
	ADDI AUX,50
EXC_SUN:
	ADDI AUX,55
	OUTPUT OCR2B,AUX
*/
ORDEN_BT_NO_TOCAR_LUZ:
RET

LIGHT_TURN_OFF:
	INPUT AUX,BT_MANUAL_LIGHT
	CPI AUX,0xFF						;[FLAG=0xFF]: LA LUZ SE MANEJA MANUAL. 
	BREQ ORDEN_BT_NO_TOCAR_LUZ			;[FLAG=0x00]: LA LUZ SE MANEJA AUTOMATICA.

	INPUT PWM_DATA,TCCR2A	;Timer/counter control register A
	ANDI PWM_DATA,(~((1<<COM2B1)|(1<<COM2B0)|(1<<WGM20)|(1<<WGM21)))
	ORI PWM_DATA,((0<<COM2B1)|(0<<COM2B0)|(1<<WGM20)|(1<<WGM21))	;fast PWM, non-inverting
	OUTPUT TCCR2A,PWM_DATA

	CLR AUX
	OUTPUT OCR2B,AUX
RET