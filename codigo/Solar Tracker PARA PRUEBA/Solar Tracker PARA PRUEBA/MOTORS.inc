;-------------------------------------------------------------------------
;
;							MOTORS.inc
;
;-------------------------------------------------------------------------
.CSEG

MOTORS_INIT:
	INPUT AUX,DDRD
	ANDI AUX,(~((1<<DDD5)|(1<<DDD6)))
	ORI AUX,((1<<DDD5)|(1<<DDD6))
	OUTPUT DDRD,AUX

	INPUT AUX,PORTD
	ANDI AUX,(~((1<<MOT_1)|(1<<MOT_2)))
	OUTPUT PORTD,AUX

	CLR	AUX
	OUTPUT	OCR1AL,AUX
	OUTPUT	OCR1AH,AUX
	OUTPUT	OCR1BL,AUX
	OUTPUT	OCR1BH,AUX
RET

MOTOR_AZIMUT_EAST:
;RECIBE EN AUX3 EL VALOR A MOVERSE EN EL PWM
;SETEO MOT_1 Y MOT_2
;SETEO LOS ENABLE
;SETEO EL PW,
	INPUT AUX,BT_MANUAL_MOTORS
	CPI AUX,0xFF						;[FLAG=0xFF]: LOS MOTORES SE MANEJAN MANUALMENTE.
	BREQ ORDEN_BT_NO_TOCAR_MOTORES			;[FLAG=0x00]: LOS MOTORES SE MANEJAN AUTOMATICAMENTE.

	INPUT PWM_DATA,TCCR1A	;Timer/counter control register A
	ANDI PWM_DATA,(~((1<<COM1A1)|(1<<COM1B1)|(1<<COM1A0)|(1<<COM1B0)|(1<<WGM10)|(1<<WGM11)))
	ORI PWM_DATA,((1<<COM1A1)|(0<<COM1A0)|(1<<WGM10)|(0<<WGM11))	;fast PWM, non-inverting
	OUTPUT TCCR1A,PWM_DATA

	INPUT AUX,PORTD
	ANDI AUX,(~((1<<MOT_1)|(1<<MOT_2)))
	ORI AUX,((0<<MOT_1)|(1<<MOT_2))			;CHEQUEAR CUANDO SE CONECTE
	OUTPUT PORTD,AUX

	CLR	AUX
	OUTPUT	OCR1AL,AUX
	rcall smooth_move_azimut
	;OUTPUT	OCR1AL,AUX1
RET

MOTOR_AZIMUT_WEST:
;RECIBE EN AUX3 EL VALOR A MOVERSE EN EL PWM
;SETEO MOT_1 Y MOT_2
;SETEO LOS ENABLE
;SETEO EL PWM
	INPUT AUX,BT_MANUAL_MOTORS
	CPI AUX,0xFF						;[FLAG=0xFF]: LOS MOTORES SE MANEJAN MANUALMENTE.
	BREQ ORDEN_BT_NO_TOCAR_MOTORES			;[FLAG=0x00]: LOS MOTORES SE MANEJAN AUTOMATICAMENTE.

	INPUT PWM_DATA,TCCR1A	;Timer/counter control register A
	ANDI PWM_DATA,(~((1<<COM1A1)|(1<<COM1B1)|(1<<COM1A0)|(1<<COM1B0)|(1<<WGM10)|(1<<WGM11)))
	ORI PWM_DATA,((1<<COM1A1)|(0<<COM1A0)|(1<<WGM10)|(0<<WGM11))	;fast PWM, non-inverting
	OUTPUT TCCR1A,PWM_DATA

	INPUT AUX,PORTD
	ANDI AUX,(~((1<<MOT_1)|(1<<MOT_2)))
	ORI AUX,((1<<MOT_1)|(0<<MOT_2))			;CHEQUEAR CUANDO SE CONECTE
	OUTPUT PORTD,AUX

	CLR	AUX
	OUTPUT	OCR1AL,AUX
	rcall smooth_move_azimut
	;OUTPUT	OCR1AL,AUX1
ORDEN_BT_NO_TOCAR_MOTORES:
RET

smooth_move_azimut:
	clr aux4
_s:	inc aux4
	OUTPUT	OCR1AL,AUX4
	OUTPUT	OCR1BL,AUX4
	RCALL DELAY_100us
	cpi aux4,170
	brsh nxt
	rcall delay_100us
	rcall delay_100us
nxt:
	rcall delay_100us
	rcall delay_100us
	cp aux4,AUX3
	brlo _s
ret

MOTOR_ELEVATION_SOUTH:
;RECIBE EN AUX3 EL VALOR A MOVERSE EN EL PWM
;SETEO MOT_1 Y MOT_2
;SETEO LOS ENABLE
;SETEO EL PWM
	INPUT AUX,BT_MANUAL_MOTORS
	CPI AUX,0xFF							;[FLAG=0xFF]: LOS MOTORES SE MANEJAN MANUALMENTE.
	BREQ ORDEN_BT_NO_TOCAR_MOTORES			;[FLAG=0x00]: LOS MOTORES SE MANEJAN AUTOMATICAMENTE.

	INPUT PWM_DATA,TCCR1A	;Timer/counter control register A
	ANDI PWM_DATA,(~((1<<COM1A1)|(1<<COM1B1)|(1<<COM1A0)|(1<<COM1B0)|(1<<WGM10)|(1<<WGM11)))
	ORI PWM_DATA,((1<<COM1B1)|(0<<COM1B0)|(1<<WGM10)|(0<<WGM11))	;fast PWM, non-inverting
	OUTPUT TCCR1A,PWM_DATA

	INPUT AUX,PORTD
	ANDI AUX,(~((1<<MOT_1)|(1<<MOT_2)))
	ORI AUX,((1<<MOT_1)|(0<<MOT_2))			;CHEQUEAR CUANDO SE CONECTE
	OUTPUT PORTD,AUX

	CLR	AUX
	OUTPUT	OCR1BL,AUX
	
	rcall smooth_move_elevation
	;OUTPUT	OCR1BL,AUX1
RET

MOTOR_ELEVATION_NORTH:
;RECIBE EN AUX3 EL VALOR A MOVERSE EN EL PWM
;SETEO MOT_1 Y MOT_2
;SETEO LOS ENABLE
;SETEO EL PWM
	INPUT AUX,BT_MANUAL_MOTORS
	CPI AUX,0xFF						;[FLAG=0xFF]: LOS MOTORES SE MANEJAN MANUALMENTE.
	BREQ ORDEN_BT_NO_TOCAR_MOTORES			;[FLAG=0x00]: LOS MOTORES SE MANEJAN AUTOMATICAMENTE.

	INPUT PWM_DATA,TCCR1A	;Timer/counter control register A
	ANDI PWM_DATA,(~((1<<COM1A1)|(1<<COM1B1)|(1<<COM1A0)|(1<<COM1B0)|(1<<WGM10)|(1<<WGM11)))
	ORI PWM_DATA,((1<<COM1B1)|(0<<COM1B0)|(1<<WGM10)|(0<<WGM11))	;fast PWM, non-inverting
	OUTPUT TCCR1A,PWM_DATA

	INPUT AUX,PORTD
	ANDI AUX,(~((1<<MOT_1)|(1<<MOT_2)))
	ORI AUX,((0<<MOT_1)|(1<<MOT_2))			;CHEQUEAR CUANDO SE CONECTE
	OUTPUT PORTD,AUX

	CLR	AUX
	OUTPUT	OCR1BL,AUX

	RCALL smooth_move_elevation
RET

smooth_move_elevation:
	clr aux4
_sM:	inc aux4
	OUTPUT	OCR1AL,AUX4
	OUTPUT	OCR1BL,AUX4
	RCALL DELAY_100us
	cpi aux4,170
	brsh nxtM
	rcall delay_100us
	rcall delay_100us
nxtM:
	rcall delay_100us
	rcall delay_100us
	cp aux4,AUX3
	brlo _sM
ret

MOTOR_AZIMUT_OFF:
;SETEO MOT_1 Y MOT_2
;SETEO LOS ENABLE
;SETEO EL PWM
	INPUT PWM_DATA,TCCR1A	;Timer/counter control register A
	ANDI PWM_DATA,(~((1<<COM1A1)|(1<<COM1B1)|(1<<COM1A0)|(1<<COM1B0)|(1<<WGM10)|(1<<WGM11)))
	ORI PWM_DATA,((1<<WGM10)|(0<<WGM11))	;fast PWM, non-inverting
	OUTPUT TCCR1A,PWM_DATA

	INPUT AUX,PORTD
	ANDI AUX,(~((1<<MOT_1)|(1<<MOT_2)))
	OUTPUT PORTD,AUX

	INPUT AUX4,OCR1AL

brake_AZIMUT:
	OUTPUT	OCR1AL,AUX4
	cpI aux4,140
	brSH	ASDF
	RCALL DELAY_100us
	RCALL DELAY_100us
ASDF:	RCALL DELAY_100us
	RCALL DELAY_100us
	RCALL DELAY_100us
	dec aux4
	brne brake_AZIMUT

	CLR	AUX
	OUTPUT	OCR1AL,AUX
RET

MOTOR_ELEVATION_OFF:
;SETEO MOT_1 Y MOT_2
;SETEO LOS ENABLE
;SETEO EL PWM
	INPUT PWM_DATA,TCCR1A	;Timer/counter control register A
	ANDI PWM_DATA,(~((1<<COM1A1)|(1<<COM1B1)|(1<<COM1A0)|(1<<COM1B0)|(1<<WGM10)|(1<<WGM11)))
	ORI PWM_DATA,((1<<WGM10)|(0<<WGM11))	;fast PWM, non-inverting
	OUTPUT TCCR1A,PWM_DATA

	INPUT AUX,PORTD
	ANDI AUX,(~((1<<MOT_1)|(1<<MOT_2)))
	OUTPUT PORTD,AUX

	INPUT AUX4,OCR1BL

brake_elevation:
	OUTPUT	OCR1BL,AUX4
	cpI aux4,170
	brSH	ASF
	RCALL DELAY_100us
	RCALL DELAY_100us
ASF:	RCALL DELAY_100us
	RCALL DELAY_100us
	RCALL DELAY_100us
	dec aux4
	brne brake_elevation

	CLR	AUX
	OUTPUT	OCR1BL,AUX

RET

RETURN_TO_ORIGIN:
;BIEN HARDCODEADO.
;EL SOL SALE DEL ESTE Y SE PONE EN EL OESTE.
	INPUT AUX,FLAG_AT_NIGHT
	CPI AUX,0xFF			;SI ESTA PRENDIDO EL FLAG, QUIERE DECIR QUE YA LO HIZO A LA NOCHE
	BREQ YA_RETORNO_AL_ORIGEN
	SER AUX
	OUTPUT FLAG_AT_NIGHT,AUX
	LDI AUX3,240
	RCALL MOTOR_AZIMUT_EAST
;	RCALL MOTOR_AZIMUT_WEST
		RCALL DELAY_500ms
		RCALL DELAY_500ms
		RCALL DELAY_500ms
		RCALL DELAY_500ms
		RCALL DELAY_500ms
		RCALL DELAY_500ms
		RCALL DELAY_500ms
		RCALL DELAY_500ms
		RCALL DELAY_500ms
		RCALL DELAY_500ms
		RCALL DELAY_500ms
		RCALL DELAY_500ms
	RCALL MOTOR_AZIMUT_OFF
YA_RETORNO_AL_ORIGEN:
RET

